
qcom,longcheer_ct865scud_4000mah_battery {
        qcom,max-voltage-uv = <0x432380>;
        qcom,nom-batt-capacity-mah = <0xfa0>;
        qcom,batt-id-kohm = <0x64>;
        qcom,battery-beta = <0x1036>;
        qcom,battery-type = "longcheer_ct865scud_4000mah_battery";
        qcom,chg-rslow-comp-c1 = <0x283713>;
        qcom,chg-rslow-comp-c2 = <0x278dbc>;
        qcom,chg-rs-to-rslow = <0x15db53>;
        qcom,chg-rslow-comp-thr = <0x99>;
        qcom,checksum = <0x6ee9>;
        qcom,gui-version = "PMI8950GUI - 2.0.0.15";
        qcom,fg-profile-data = [
		ea 83 46 7d 
		93 81 36 7c 
		5b 83 d7 67 
		fd 82 39 8d 
		1f 82 ff 98 
		b3 b6 01 c2 
		64 18 fe 83 
		af 7d ea 81 
		94 7c 82 83 
		59 7d ef 90 
		07 9c 37 82 
		06 99 13 b7 
		a4 c2 52 16 
		1f 10 be 58 
		14 70 ee fc 
		6e 3c e9 45 
		43 40 00 00 
		33 47 af 33 
		ce 34 00 00 
		00 00 00 00 
		00 00 00 00 
		17 72 76 70 
		7a 69 06 83 
		d4 75 ba 68 
		a5 5a 63 79 
		50 6f 89 5a 
		41 67 92 a2 
		21 2f 68 50 
		65 a0 71 0c 
		28 00 ff 36 
		f0 11 30 03 
		00 00 00 0c
	];
};
